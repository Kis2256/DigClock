// змінено TWI0 для старіших версій AVR

#include <avr/io.h>
#include "I2C_Master.h"

// ініціалізація I2C
void I2C_Init(void)
{
	TWBR = 32;  // частота передачі (залежить від F_CPU)
	TWSR = 0x00;  // Прескейлер = 1
}


uint8_t I2C_Write(uint8_t slaveAddr7b, uint8_t *data, uint8_t size) // функція використовується для відправки даних по I2C ( slaveAddr7b - 7-бітна I2C-адреса пристрою,
{																	// *data - вказівник на масив даних,  size - скільки байтів передати )
	TWCR = (1 << TWINT) | (1 << TWSTA) | (1 << TWEN); // генерує умову, щоб почати передачу
	while (!(TWCR & (1 << TWINT))); // чекає, поки операція старту завершиться
	TWDR = (slaveAddr7b << 1);   // записуємо 7-бітну адресу пристрою, зсунуту вліво на 1, щоб звільнити молодший біт під RW 
	TWCR = (1 << TWINT) | (1 << TWEN); // відправляємо адресу і RW біт
	while (!(TWCR & (1 << TWINT)));  // чекаємо завершення передачі
// перевіряємо статус передачі в TWSR
	if ((TWSR & 0xF8) != 0x18) // 0x18 означає, що відправлено slave address і write bit, acknowledge отримано
	{
	// якщо адреса не підтверджена пристроєм - повертає помилку
		TWCR = (1 << TWINT) | (1 << TWEN) | (1 << TWSTO); 
		return 1;  
	}
	// передає байти даних по черзі
	for (uint8_t i = 0; i < size; i++)
	{
		TWDR = data[i]; // завантажує байт в регістр передачі
		TWCR = (1 << TWINT) | (1 << TWEN);  // запускає передачу байту
		while (!(TWCR & (1 << TWINT))); // чекає завершення передачі байту
// перевіряє, чи отримано підтвердження від приймача
		if ((TWSR & 0xF8) != 0x28)   // 0x28 означає, що дані відправлено
		{
			// якщо приймач не підтвердив - повертає помилку
			TWCR = (1 << TWINT) | (1 << TWEN) | (1 << TWSTO);
			return 1;  
		}
	}
 // Завершує передачу
	TWCR = (1 << TWINT) | (1 << TWEN) | (1 << TWSTO);
	return 0;  
}

